## config/west.yml
```yaml
manifest:
  remotes:
    - name: zmkfirmware
      url-base: https://github.com/zmkfirmware
    - name: vrinek
      url-base: https://github.com/vrinek/
  projects:
    - name: zmk
      remote: vrinek
      revision: masked-mod-morphs-untested
      import: app/west.yml
  self:
    path: config
```
